#include "BasicMovement.h"        // Связь с .h
#include "DataSerial.h"
#include "Settings.h"
#include "Sensors.h"
#include "LightingEffects.h"          // Подключение класса
#include <SoftwareSerial.h>
#include <Ultrasonic.h>           // подключаем библиотеку сенсоров

// Внешние зависимости 
extern Ultrasonic TopSensor;
extern Ultrasonic BottomSensor;
extern DataSerial dataSerial;

extern int default_Array[];
extern int data_Array[];  // Глобальный массив параметров
extern bool Flags_Array[];
extern bool dark;
extern int darkness;

// переменные для работы с счетчиками времени
extern unsigned long startTime;
extern unsigned long currentTime;

#define FOTO A1                       // устанавливаем контакт для фоторезистора

//------------ Проверка сенсоров -----------------------------------------------------------------------------------------------------------
int Sensors::sensorsCheck (Ultrasonic sensor, int operateNumber) {
  byte tempNumber = operateNumber;
  int dist_3[3] = {0, 0, 0};                        // массив для хранения трёх последних измерений
  int dist = 0;                                         // переменная для текущей дистанции
  int result = 0;

  do {												// выполняем
    for (int i = 0; i < 3; i++) {                    	// счётчик от 0 до 2
      dist_3[i] = sensor.Ranging(CM);                  		// пишем дистанцию с датчика (в см.) в текущую ячейку массива
      delay(data_Array[5]);                            		// небольшая задержка необходима, чтобы эхо предыдущего сигнала не искажало текущий
    }
      dist = middle(dist_3[0], dist_3[1], dist_3[2]);   	// фильтровать медианным фильтром из 3-х последних измерений
      result += dist;										// сохраняем полученное значение
      tempNumber --;										// уменьшаем счетчик срабатываний
  } while (tempNumber > 0);							//пока счетчик больше ноля
  
    result = result / operateNumber;   				// делим полный результат на количество циклов измерений
    return result;                                  // вернем в функцию отфильтрованное значение дистанции
}
//==========================================================================================================================================

//------------ медианный фильтр из 3ёх значений --------------------------------------------------------------------------------------------
int Sensors::middle(int a, int b, int c) {
  int middle;
  if ((a <= b) && (a <= c)) {                 // если a <= b и a <= c
    middle = (b <= c) ? b : c;                  // среднее равно b, если b <= c или c, если c < b
  }
  else if ((b <= a) && (b <= c)) {            // если b <= a и b <= c
      middle = (a <= c) ? a : c;                // среднее равно a, если a <= c или c, если c < a
    }
    else {                                    // если c <= a и c <= b
      middle = (a <= b) ? a : b;                // среднее равно a, если a <= b или b, если b < a
    }
  return middle;                              // вернем в функцию среднее значение
}
//==========================================================================================================================================

//------------ Проверка Темно или Светло ---------------------------------------------------------------------------------------------------
bool Sensors::darkOrLight() {  // создаем булеву функцию проверки показаний фоторезистора (день или ночь)

    int FotoElem = 0;                       // переменная для снятия показаний фоторезистора;
    int a = 0, b = 0;                                // переменные для гистерезиса (а-включение-ночь, b-выключение-день)

    for(int i = 0; i < 1000; i++) {                  // запускаем счетчик от "0" до "1000"
        FotoElem = analogRead(FOTO);                     // пишем в переменную текущеее значение с фоторезистора
        if (FotoElem > data_Array[0]) {                  // если значение фоторезистора больше (темнее) референсного значения;
            a++;                                            // увеличиваем a
            b = 0;                                          // обнуляем b
          } else if (FotoElem < (data_Array[0] - data_Array[1])) {       // иначе, если значение меньше (светлее), чем референсное значение минус допуск на гистерезис;
            b++;                                            // увеличиваем b
            a = 0;                                          // обнуляем a
          }
      }
    if (!dark && (a > 999)) {                        // если светло и a больше 999
         dark = true;                                   // устанавливаем - темно!
      } else if (dark && (b > 999)) {                // иначе, если темно и b больше 999
         dark = false;                                  // устанавливаем - светло!
      } else {                                       // в остальных случаях
        a = 0;                                          // обнуляем a, b
        b = 0;
      }
    return dark;                                      // возвращаем в функцию значение темно или светло!
 }
//==========================================================================================================================================

//------------ Проверка День или Ночь ------------------------------------------------------------------------------------------------------
bool Sensors::dayOrNight() {  // создаем булеву функцию проверки показаний фоторезистора (день или ночь)
  
  currentTime = millis();                       // сохраняем в переменную текущее время в мс.
  bool oldValue = Flags_Array[2];

  if (currentTime - startTime >= 1000UL) {          // если разница между временем старта и текущим временем более или равна 1 сек.
    startTime = currentTime;                        	// стартовое время скинем до текущего

    switch (darkOrLight()) {                           	// запускаем проверку светло/темно 
      case true:                  							// если темно
        if (Flags_Array[2]){                 					// и если ночь (флаг night)
          Flags_Array[2] = true;               						// подтверждаем ночь
          darkness = 0;               								// обнуляем счетчик темноты
        } else darkness --;         							//если день, уменьшаем счетчик темноты
        break;
      case false:                 							// если светло
        if (!Flags_Array[2]){               					// и если день
          Flags_Array[2] = false;              						// подтверждаем день
          darkness = 0;              								// обнуляем счетчик темноты
        } else darkness ++;;       								// иначе, если ночь,  увеличиваем счетчик темноты
        break;
    }
              // дополнительный фильтр день/ночь на случая кратковременных изменений (облака, тени и т.д.)
      if (darkness == -5) {       						// если счетчик темноты достиг -5
        darkness = 0;               						// обнуляем счетчик темноты
        Flags_Array[2] = true;               				// устанавливаем ночь
      }
      if (darkness == 5) {        						// если счетчик темноты достиг 5
        darkness = 0;               						// обнуляем счетчик темноты
        Flags_Array[2] = false;              				// устанавливаем день
      } 
  }

  if (oldValue != Flags_Array[2]) {
    Flags_Array[2] ? dataSerial.outData (4, "Night", 1) : dataSerial.outData (4, "Day", 1);           // сообщение оператору, режим День/Ночь
  }

  return Flags_Array[2];
 }
//==========================================================================================================================================

