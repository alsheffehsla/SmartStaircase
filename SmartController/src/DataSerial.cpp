#include "DataSerial.h"        
#include "LightingEffects.h"        
#include "BasicMovement.h"
#include "Settings.h"
#include "Sensors.h"
#include <Ultrasonic.h>           // подключаем библиотеку сенсоров
#include <Tlc5940.h>              // подключаем библиотеку драйвера
#include <EEPROM.h>
#include <SoftwareSerial.h>


// Внешние зависимости 
extern int default_Array[17];
extern int data_Array[17];  // Глобальный массив параметров
extern bool stop;

extern Ultrasonic TopSensor;
extern Ultrasonic BottomSensor;
extern bool allStair;                 // флаг срабатывания функции allStairWork()
extern SoftwareSerial btSerial; 		  // RX, TX - ноги контроллера для связи с BLE устройством
extern bool data_flag;
extern String dataCollect;			  // промежуточная строка при приеме длинного пакета данных
extern String dataIn;                   // переменная для входных данных

extern int temp_Array[17];
extern bool Flags_Array[];
extern unsigned long standByTime;
extern LightingEffects lightEffects;
extern BasicMovement myStaircase;
extern Settings settings;

//--------- Проверка наличия входных данных ------------------------------------------------------------------------------------------------
bool DataSerial::dataAvailable(){  
  while (btSerial.available()>0){                // если данные поступили
      dataIn += (char)btSerial.read();              // набиваем переменную данными
      data_flag = true;                             // устанавливаем флаг, что данные получены
      delay(1);                                     // маленькая задержка (без нее коряво работает)
  }

  // здесь проверяем длинные пакеты с данными для настроек. Общий пакет разбит на части по 20 или 60 Байт и содержит дополнительные символы //  
  if (dataIn.endsWith("^")) {                        // если принятая строка заканчивается на промежуточный символ "^"
      dataCollect += dataIn.substring(0, dataIn.length() - 1);     // сохраняем строку без последнего символа   
      dataCollect.replace("^",""); 
      dataIn = "";                                                    // очищаем входную строку
      data_flag = false;                                              // снимаем флаг
    if (dataCollect.endsWith("|")) {                                // если строка заканчивается "|" (конец посылки)
      dataCollect = dataCollect.substring(1, dataCollect.length() - 2);       // обрезаем первый (#) и два последних символа (#|) строки
      outData(3, "Set.receive", 0);                                     // сообщение оператору, данные получены
      getSettings(dataCollect);                                         // парсим строку
      dataCollect = "";                                             // обнуляем накопленную подстроку
      }
  } else if (dataIn.length() >= 20) outData(2, dataIn,0);
 
  if (dataIn.indexOf("$") != -1) {              // если строка содержит символ '$'
    stop = true;									                  // поднимаем СТОП-флаг
    dataIn = "";                                    // очищаем входные данные
    data_flag = false;
  }
  
  if (dataIn == "@X") {                         // если строка = @X - опрос состояния
    statusMode();                                   // отвечаем на запрос
    dataIn = "";                                    // очищаем входные данные
    data_flag = false;
  }
  return data_flag;
}
//==========================================================================================================================================

//--------- Блок разбора полученных данных -------------------------------------------------------------------------------------------------
void DataSerial::dataParse() {

    String command = dataIn.substring(1);           // переносим данные в новую переменную без первого символа 
    
    switch ((uint8_t)dataIn[0]){                             // ищем совпадение по первому символу (в полной строке)
    //::::::: Блок разбора и сохранения настроек ::::::::::::::::::::::::::::::::::::::::::::::::::::::::::::::::::::::::::::::::::::::::://
      case 0x23:                                     // (ASCII '#')  
        if (command.endsWith("#")) {                              // если строка заканчивается #
          command = command.substring(0, command.length() - 1);       // обрезаем последний символ строки          
          getSettings(command);                                       // парсим строку
        } else {
          outData(2, command, 0);               // иначе - сообщение пользователю "Неверные данные"
        }
        arrayComparison();                      // проверяем, установлены ли дефолтные настройки 
        break;
    //::::::::::::::::::::::::::::::::::::::::::::::::::::::::::::::::::::::::::::::::::::::::::::::::::::::::::::::::::::::::::::::::::::://

    //::::::: Блок запроса значения из EEPROM по адресу ::::::::::::::::::::::::::::::::::::::::::::::::::::::::::::::::::::::::::::::::::://
      case 0x21:                                     // (ASCII '!')            
        request(command);                                // запрашиваем нужные данные из EEPROM 
        break;
    //::::::::::::::::::::::::::::::::::::::::::::::::::::::::::::::::::::::::::::::::::::::::::::::::::::::::::::::::::::::::::::::::::::://

    //::::::: Блок запроса флагов состояний контроллера ::::::::::::::::::::::::::::::::::::::::::::::::::::::::::::::::::::::::::::::::::://
      case 0x3F:                                     // (ASCII '?')             
        settings.statesOfFlags(command);                          // запрашиваем нужные флаги состояний
        break;
    //::::::::::::::::::::::::::::::::::::::::::::::::::::::::::::::::::::::::::::::::::::::::::::::::::::::::::::::::::::::::::::::::::::://

    //::::::: Блок вывода данных из рабочего массива :::::::::::::::::::::::::::::::::::::::::::::::::::::::::::::::::::::::::::::::::::::://  
      case 0x26:                                     // (ASCII '&') 
            for (int i=0; i < (int)(sizeof(default_Array)/sizeof(int)); i++){		// вернем целиком рабочий массив
              btSerial.print(data_Array[i]);
              btSerial.print(":");
            }
            btSerial.println();
                break;
    //::::::::::::::::::::::::::::::::::::::::::::::::::::::::::::::::::::::::::::::::::::::::::::::::::::::::::::::::::::::::::::::::::::://

    //::::::: Блок вывода данных из дефолтного массива :::::::::::::::::::::::::::::::::::::::::::::::::::::::::::::::::::::::::::::::::::://  
      case 0x25:                                     // (ASCII '%') 
            for (int i=0; i < (int)(sizeof(default_Array)/sizeof(int)); i++){	// вернем целиком дефолтный массив
              btSerial.print(default_Array[i]);
              btSerial.print(":");
            }
            btSerial.println();
        break;
    //::::::::::::::::::::::::::::::::::::::::::::::::::::::::::::::::::::::::::::::::::::::::::::::::::::::::::::::::::::::::::::::::::::://

    //::::::: Блок для вывода данных из EEPROM :::::::::::::::::::::::::::::::::::::::::::::::::::::::::::::::::::::::::::::::::::::::::::://  
      case 0x7C:                                     // (ASCII '|') 
        EEPROM.get(0,temp_Array);
            for (int i=0; i < (int)(sizeof(default_Array)/sizeof(int)); i++){	// вернем целиком массив из EEPROM
              btSerial.print(temp_Array[i]);
              btSerial.print(":");
              temp_Array[i] = 0;
            }
            btSerial.println();
        break;
    //::::::::::::::::::::::::::::::::::::::::::::::::::::::::::::::::::::::::::::::::::::::::::::::::::::::::::::::::::::::::::::::::::::://

    //::::::: Блок сброса настроек к дефолту (обнуление ключа EEPROM, после перезагрузки контроллер подгрузит дефолтные значения) ::::::::://
      case 0x7E:                                       // (ASCII '~')   
        EEPROM.put(1000,255);								// затираем ключ
        break;
    //::::::::::::::::::::::::::::::::::::::::::::::::::::::::::::::::::::::::::::::::::::::::::::::::::::::::::::::::::::::::::::::::::::://

    //::::::: Блок быстрого сброса настроек к дефолту (грузим в контроллер дефолтные значения) ::::::::::::::::::::::::::::::::::::::::::::::::::::://
      case 0x2A:                                       // (ASCII '*')
        memcpy(data_Array, default_Array, sizeof(default_Array));            // переписываем дефолтный массив в рабочий
        arrayComparison();                      // сверяем, установлены ли дефолтные настройки
        break;
    //::::::::::::::::::::::::::::::::::::::::::::::::::::::::::::::::::::::::::::::::::::::::::::::::::::::::::::::::::::::::::::::::::::://

    ///::::::: Блок получения команд сценариев :::::::::::::::::::::::::::::::::::::::::::::::::::::::::::::::::::::::::::::::::::::::::::://
       case 0x40:                                   // (ASCII '@') 
        stop = false;                                      // снимаем СТОП-флаг
        scenarioParser(command);                           // парсим строку принятых данных
        break;
    //::::::::::::::::::::::::::::::::::::::::::::::::::::::::::::::::::::::::::::::::::::::::::::::::::::::::::::::::::::::::::::::::::::://  

    ///::::::: Блок получения команд режима Охраны :::::::::::::::::::::::::::::::::::::::::::::::::::::::::::::::::::::::::::::::::::::::::::://
       case 0x3E:                                   // (ASCII '>') 
        stop = false;                                      // снимаем СТОП-флаг
        Flags_Array[11] = true;                             // флаг режима Охраны
        outData (4, "SecurityON", 0);                                // сообщение оператору, что флаг режима Охраны выставлен
        securityParser(command);                           // парсим строку принятых данных
        break;
    //:::::::::::::::::::::::::::::::::::::::::::::::::::::::::::::::::::::::::::::::::::::::::::::::::::::::::::::::::::::::::::::::::::::// 

    ///::::::: Блок отключения режима Охраны :::::::::::::::::::::::::::::::::::::::::::::::::::::::::::::::::::::::::::::::::::::::::::://
       case 0x3C:                                   // (ASCII '<') 
        myStaircase.actionSTOP();                                         // вызываем функцию СТОП
        Flags_Array[11] = false;                             // флаг режима Охраны
        outData (4, "SecurityOFF", 0);                                 // сообщение оператору, что флаг режима Охраны снят
        Flags_Array[12] = false;                             // флаг контроля сенсоров в режиме Охраны
        outData (4, "SensControlOFF", 0);                                 // сообщение оператору, что флаг контроля сенсоров снят
        Flags_Array[13] = false;                             // флаг SOS в режиме Охраны
        outData (4, "SOSsecurityOFF", 0);                                // сообщение оператору, что флаг SOS в режиме Охраны снят
        break;
    //:::::::::::::::::::::::::::::::::::::::::::::::::::::::::::::::::::::::::::::::::::::::::::::::::::::::::::::::::::::::::::::::::::::// 

    //::::::: Блок ошибки (если команда не распознана) :::::::::::::::::::::::::::::::::::::::::::::::::::::::::::::::::::::::::::::::::::://
      default:                                    // если совпадений нет
        outData(1, dataIn.substring(0, 1), 0);                 // сообщение пользователю "Неверная команда"
        break;
    //::::::::::::::::::::::::::::::::::::::::::::::::::::::::::::::::::::::::::::::::::::::::::::::::::::::::::::::::::::::::::::::::::::://
    }
    dataIn = "";                                  // обнуляем входные данные
    command = "";
}
//==========================================================================================================================================


//------------ Блок вывода значения из EEPROM по запросу -----------------------------------------------------------------------------------
void DataSerial::request (String comm){            // принимаем значение
  int t;
  int ini = comm.toInt();           // преобразовываем его в адрес
  EEPROM.get(ini*2, t);                 // вытаскиваем данные из EEPROM по данному адресу из массива
  btSerial.println(t);                  // отправляем значение
}
//==========================================================================================================================================


//------------ Блок проверки изменения в дефолтных настройках ------------------------------------------------------------------------------
bool DataSerial::arrayComparison (){            // 
  bool compare = Flags_Array[1];
  if (sizeof(default_Array) != sizeof(data_Array)) {
      compare = false;
  } else {
      int n = sizeof(default_Array) / sizeof(default_Array[0]);
      for (int i = 0; i < n; ++i) {
          if (default_Array[i] != data_Array[i]) {
              compare = false;
              break;
          }
        compare = true;
      }

  }
  compare ? Flags_Array[1] = 1 : Flags_Array[1] = 0;
  compare ? outData(4,"SettingsDefault",1) : outData(4,"SettingsNoDefault",1);

  return compare;
}
//==========================================================================================================================================



//------------ Блок парсера пользовательских настроек с записью в память и рабочий массив --------------------------------------------------
void DataSerial::getSettings (String data) {                      // получаем блок данных (строка с данными и разделителями)

  String temp;
  int addr, val;
  do {                                                        // выполнить
    if (data.indexOf(";", 0) != -1) {                             // если блок содержит хоть один разделитель ';' 
      temp = data.substring(0, data.indexOf(";", 0));                 // во временную переменную пишем подстроку до ближайшего разделителя ';'
      data.remove(0, data.indexOf(";", 0)+1);                         // обрезаем блок от начала вместе с разделителем ';'      
      if (temp[1] == ':' || temp[2] == ':') {                         // если 2-й или 3-й символ это разделитель ':'
        addr = temp.substring(0,temp.indexOf(":", 0)).toInt();          // записываем в переменную адрес (значение до разделителя ':')
        val = temp.substring(temp.indexOf(":", 0)+1).toInt();           // записываем в переменную само значение (после разделителя ':')
        if (addr == 99) {                                               // если адрес = 99 (спец.команда)
          lightEffects.onlineBright(val);                                              // то вызов функции немедленного изменения яркости
        } else {                                                        // иначе
          data_Array[addr] = val;                                         // пишем значение по указанному адресу в рабочий массив
          EEPROM.put((addr)*2,val);                                       // пишем значение по указанному адресу в EEPROM
        }
      }
    } else {                                                      
      outData(2, data, 0);                                        // иначе - сообщение пользователю "Неверные данные"
      break;
    }
  } while (data != "");                                       // повторяем цикл, пока не закончится блок с данными

  if (addr != 99) {
    outData(4, "Set.get", 0);                                   // ответ пользователю, что настройки применены
    lightEffects.all(0, 0);                                                      // выключаем все, чтобы в следующем рабочем цикле применились новые настройки
  }
  
  temp = "";                                                  // обнуляем переменные
  val = 0; 
  addr = 0;
  arrayComparison();                      // проверяем, установлены ли дефолтные настройки 
}
//==========================================================================================================================================

//------------ Блок парсера режима Охраны -------------------------------------------------------------------------------------------------------
void DataSerial::securityParser (String data){                                     // получаем данные
  String tempdata;
  dataIn = "";                                              // очищаем входные данные
  data_flag = false;
  do {                                                     
    tempdata = data.substring(0, 1);                           // пишем в переменную первый символ
    data.remove(0,1);                                          // удаляем первый символ из набора команд
    switch (tempdata.charAt(0)) {                              // ищем совпадение по символу
      case 0x5A:                                                    // (ASCII 'Z') включить контроль сенсоров
        Flags_Array[12] = true;                                         // флаг контроля сенсоров в режиме Охраны
        outData (4, "SensControlON", 0);                                       // сообщение оператору, что флаг контроля сенсоров выставлен
        break;
      case 0x45:                                                    // (ASCII 'E') включение SOS в режиме Охраны
        Flags_Array[13] = true;                                         // флаг SOS в режиме Охраны
        outData (4, "SOSsecurityON", 0);                                       // сообщение оператору, что флаг SOS выставлен
        break;
      default:                                                      // если совпадений нет
        outData (2, tempdata, 0);                         // сообщение оператору "Неверные данные"
        break;
    }     
  } while (data != "");                                   // пока не кончатся команды
  stop = false;
}
//==========================================================================================================================================


//------------ Блок парсера сценариев -------------------------------------------------------------------------------------------------------
void DataSerial::scenarioParser (String data){                                     // получаем данные
  String tempdata;
  String cycledata = data;                                  // сохраняем набор команд на случай зацикливания !
  dataIn = "";                                              // очищаем входные данные
  data_flag = false;
  do {                                                     
    if (stop){                                              // если флаг СТОП
		Flags_Array[3] = false;                                 // отмена зацикливания сценариев
		cycledata = "";                                         // переменную с набором команд тоже очищаем
		break;                                                  // выходим из цикла                     
    } 
    tempdata = data.substring(0, 1);                           // пишем в переменную первый символ
    data.remove(0,1);                                          // удаляем первый символ из набора команд
    switch (tempdata.charAt(0)) {                              // ищем совпадение по символу
      
      case 0x4F:                                                    // (ASCII 'O') включение контроллера лестницы
        myStaircase.actionSTOP();                                         // вызываем функцию СТОП
        Flags_Array[0] = false;                                     // выход из режима ожидания (флаг StandBy)
        outData (4, "StandByOFF", 1);                               // сообщение оператору, режим выключен
        Flags_Array[11] = false;                                    // снимаем флаг режима Охраны
        outData (4, "SecurityOFF", 0);                                 // сообщение оператору, что флаг режима Охраны снят
        Flags_Array[12] = false;                                    // снимаем флаг контроля сенсоров в режиме Охраны
        Flags_Array[13] = false;                                    // снимаем флаг SOS в режиме Охраны
        break;
      case 0x6F:                                                    // (ASCII 'o') выключение контроллера лестницы
        Tlc.setAll(0);                                                // тушим все ступени
        Tlc.update();
        standByTime = millis();											// запоминаем время старта режима StandBy
        Flags_Array[0] = true;                                          // переход в режим ожидания (флаг StandBy)
        outData (4, "StandByON", 1);                                    // сообщение оператору, режим включен
        break;
      case 0x50:                                                    // (ASCII 'P') резерв

        break;
      case 0x58:                                                    // (ASCII 'X') запрос состояния контроллера лестницы
        dataIn = "";
        statusMode();                                                 // функция ответа на запрос 
        break;
      case 0x55:                                                    // (ASCII 'U') команда включения вверх
        Flags_Array[4] = true;
        myStaircase.move(0, data_Array[10], data_Array[14], 1, 1, 0);                     // включаем ступени последовательно вверх
        Flags_Array[4] = false;
        break;
      case 0x75:                                                    // (ASCII 'u') команда выключения вверх
        Flags_Array[4] = true;
        myStaircase.move(data_Array[10], 0, data_Array[14], 1, 0, 0);                     // выключаем ступени последовательно вверх
        Flags_Array[4] = false;
        break;
      case 0x44:                                                    // (ASCII 'D') команда включения вниз
        Flags_Array[5] = true;
        myStaircase.move(0, data_Array[10], data_Array[14], 0, 1, 0);                   // включаем ступени последовательно вниз
        Flags_Array[5] = false;
        break;
      case 0x64:                                                    // (ASCII 'd') команда выключения вниз
        Flags_Array[5] = true;
        myStaircase.move(data_Array[10], 0, data_Array[14], 0, 0, 0);                   // выключаем ступени последовательно вниз
        Flags_Array[5] = false;
        break;
      case 0x41:                                                    // (ASCII 'A') команда включения всех ступеней
        Flags_Array[6] = true;
        lightEffects.all(data_Array[10], 1);                                       // включаем все ступени разом
        break;
      case 0x61:                                                    // (ASCII 'a') команда выключения всех ступеней
        Flags_Array[6] = false;
        lightEffects.all(0, 0);                                                    // выключаем все ступени разом
        break;
      case 0x46:                                                    // (ASCII 'F') команда включения в разные стороны
        Flags_Array[7] = true;
        lightEffects.different(0, data_Array[10], data_Array[14], 1);              // включаем ступени от середины в разные стороны
        Flags_Array[7] = false;
        break;
      case 0x66:                                                    // (ASCII 'f') команда выключения в разные стороны
        Flags_Array[7] = true;
        lightEffects.different(data_Array[10], 0, data_Array[14], 0);              // выключаем ступени от середины в разные стороны
        Flags_Array[7] = false;
        break;
      case 0x54:                                                    // (ASCII 'T') команда включения навстречу
        Flags_Array[8] = true;
        lightEffects.towards(0, data_Array[10], data_Array[14], 1);                // включаем ступени навстречу с разных сторон
        Flags_Array[8] = false;
        break;
      case 0x74:                                                    // (ASCII 't') команда выключения навстречу
        Flags_Array[8] = true;
        lightEffects.towards(data_Array[10], 0, data_Array[14], 0);                // выключаем ступени навстречу с разных сторон
        Flags_Array[8] = false;
        break;
      case 0x53:                                                    // (ASCII 'S') SOS
        Flags_Array[9] = true;
        lightEffects.sos(4095, 0);                                                 // режим SOS, (максимальная яркость, зациклить- 1 или один раз- 0)
        Flags_Array[9] = false;
        break;
      case 0x4C:                                                    // (ASCII 'L') режим люминесцентной лампы
        Flags_Array[10] = true;
        lightEffects.luminescent(data_Array[10]);                                  // включаем все ступени с эффектом люминесцентной лампы
        Flags_Array[10] = false;
        break;
      case 0x43:                                                    // (ASCII 'C') зациклить сценарии
        Flags_Array[3] = true;
        break;
      case 0x63:                                                    // (ASCII 'c') отмена зацикливания сценариев
        Flags_Array[3] = false;
        break;
      default:                                                      // если совпадений нет
        outData (2, tempdata, 0);                         // сообщение оператору "Неверные данные"
        break;
    }     
    if (Flags_Array[3] && data == "") {                       // если установлен флаг зацикливания и команды закончились
      data = cycledata;                                     // восстанавливаем набор команд
    }
  } while (data != "");                                   // пока не кончатся команды
  stop = false;
}
//==========================================================================================================================================


//------------ Блок вывода сообщений пользователю ------------------------------------------------------------------------------------------
void DataSerial::outData (int value, String dataOut, byte additional){              // принимаем блок данных (вид сообщения, данные, дополнительные данные)
  switch (value) {                                        // ищем совпадения по значению
    case 1:                                                   // если 1, то 
      btSerial.println(100);              // вывод сообщения "Неверная команда" со значением команды
      break;
    case 2:                                                   // если 2, то 
      btSerial.println(200);              // вывод сообщения "Неверные данные" со значением
      break;
    case 3:                                                   // если 3, то 
      btSerial.print(300);              // вывод сообщения "Команда принята" со значением    
      btSerial.print(",");  
      break;
    case 4:                                                   // если 4, то
      btSerial.print(400);              // вывод сообщения "Команда выполнена" со значением
      btSerial.print(",");
      break;
    case 5:
      btSerial.print(500);              // вывод сообщения "Состояние ОК" со значением ???????
      btSerial.print(",");
      break;
    default:
      btSerial.print(600);              // внутренняя ошибка  ????? резерв ???
      btSerial.print(",");
  }

  btSerial.println(dataOut);            // отправка без additional
  // btSerial.print(dataOut + ",");
  // btSerial.println(additional);
}
//==========================================================================================================================================


//------------ Ответ на запрос состояния ---------------------------------------------------------------------------------------------------
void DataSerial::statusMode() {         // считаем, что при получении запроса состояния НЕ нужно тушить лестницу, как в режиме StandBy
  standByTime = millis();   						// записываем время активации флага StandBy
//  Tlc.setAll(0);                                                // тушим все ступени
//  Tlc.update();
  Flags_Array[0] = true;    						// поднимаем флаг StandBy
  outData (4, "StandByON", 1);                                     // сообщение оператору, режим включен
  btSerial.println("OK");   						// шлем ответ на запрос состояния

  if (Flags_Array[11]) outData(4,"221",1);   						// шлем ответ на запрос состояния
}
//==========================================================================================================================================

